#include <FastLED.h>

#define LIGHT_SENSOR_PIN  A0
#define LIGHT_MIN        200
#define LIGHT_MAX        900
#define NUM_LEDS          64
#define DATA_PIN           6
#define BRIGHNESS         64

//#define DEBUG

CRGB leds[NUM_LEDS];
int c = 0;
int dot = 0;
int b = 10;
unsigned int randomDot = 0;

const unsigned int FacePixelMap[64] = {
  7,  8, 23, 24, 39, 40, 55, 56, 
  6,  9, 22, 25, 38, 41, 54, 57, 
  5, 10, 21, 26, 37, 42, 53, 58, 
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  0, 15, 16, 31, 32, 47, 48, 63
};

unsigned int currentFace = 0;
unsigned int brightness = 0;
unsigned int timeToUpdate = 60; // cycles by 50 ms delay, 50*60 = 3000 = 3 seconds

bool usedPoint[64] = { 
  false, false, false, false, false, false, false, false, 
  false, false, false, false, false, false, false, false, 
  false, false, false, false, false, false, false, false, 
  false, false, false, false, false, false, false, false, 
  false, false, false, false, false, false, false, false, 
  false, false, false, false, false, false, false, false, 
  false, false, false, false, false, false, false, false, 
  false, false, false, false, false, false, false, false
};


const unsigned int maxFaces = 7;

const PROGMEM byte imgFaces[192*maxFaces] = { 
  0xff, 0xa8, 0x00, 0xff, 0xff, 0x00, 0xff, 0x4e, 0x00, 0xdd, 0x00, 0x00,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 0x00,
  0x78, 0x00, 0x00, 0x95, 0x00, 0x00, 0xaf, 0x00, 0x00, 0xaf, 0x00, 0x00,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 0x00,
  0x1e, 0x0b, 0x00, 0x19, 0x09, 0x00, 0x1e, 0x0a, 0x00, 0x15, 0x07, 0x00,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 0x22,
  0xac, 0xdd, 0xa5, 0x00, 0xb1, 0x00, 0x41, 0xbd, 0x33, 0xa3, 0xd6, 0xa3,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 0x4e,
  0x00, 0x00, 0x2e, 0x00, 0x00, 0x3a, 0x00, 0x00, 0x38, 0x00, 0x00, 0x3a,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 0x36,
  0x14, 0x0b, 0x0b, 0x14, 0x0b, 0x0b, 0x14, 0x0b, 0x0b, 0xfa, 0xfa, 0xfa,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 0x22,
  0xe6, 0xff, 0xff, 0xff, 0xff, 0xff, 0xac, 0xdf, 0xff, 0x37, 0xa0, 0xff,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 0xff
};

unsigned int imgFacesOffset = 0;

byte imgFace[192] = {};


void LoadFace(unsigned int id) {
  imgFacesOffset = 192*id;
  for (byte i = 0; i < 192; i++) {
    imgFace[i] = pgm_read_word_near(imgFaces + imgFacesOffset + i);
  }
}

void DisplayLEDFace () {
  for(int i = 0; i < NUM_LEDS; i++) { 
    dot = FacePixelMap[i];
    leds[dot].r = imgFace[i*3+0];
    leds[dot].g = imgFace[i*3+1];
    leds[dot].b = imgFace[i*3+2];
  }
  FastLED.show();
}

void setup() {
  #ifdef DEBUG
    Serial.begin(9600);
  #endif
  //pinMode(LED_BUILTIN, OUTPUT);
  // put your setup code here, to run once:
  FastLED.addLeds<NEOPIXEL, DATA_PIN>(leds, NUM_LEDS).setCorrection(TypicalLEDStrip);
  FastLED.setBrightness(BRIGHNESS);
  LoadFace(0);
  DisplayLEDFace();
}


void loop() {
  setBrightness();
  //digitalWrite(LED_BUILTIN, LOW);
  if (!FaceDelay()) {
    FaceTransition();
  } else {
    FastLED.show();
  }
  delay(50);
  //digitalWrite(LED_BUILTIN, HIGH);
  //delay(10);
}

bool FaceTransitionDone() {
  for(int i = 0; i < NUM_LEDS; i++) { 
    if (usedPoint[i] == false) return false;
  }
  return true;
}

void setBrightness() {
  brightness = map(analogRead(LIGHT_SENSOR_PIN), LIGHT_MIN, LIGHT_MAX, 16, BRIGHNESS);
  FastLED.setBrightness(brightness);
}

bool FaceDelay() {
  if (FaceTransitionDone()) {
    if (timeToUpdate == 0) timeToUpdate = 61;
    if (timeToUpdate > 1) {
      timeToUpdate--;
      #ifdef DEBUG
        Serial.println(timeToUpdate);
      #endif
      return true;
    }
  }
  return false;
}

void FaceTransitionUnUsed() {
  for(int i = 0; i < NUM_LEDS; i++) { 
    usedPoint[i] = false;
  }
}

void FaceTransition() {
  if (FaceTransitionDone()) {
    #ifdef DEBUG
      Serial.println("Face done");
    #endif
    timeToUpdate = 0;
    FaceTransitionUnUsed();
    currentFace++;
    if (currentFace >= maxFaces) currentFace=0;
    LoadFace(currentFace);
    #ifdef DEBUG
      Serial.print("Face to ");
      Serial.println(currentFace);
    #endif
  }
  while (true) {
    randomDot = random(0, NUM_LEDS);
    if (usedPoint[randomDot] == false) {
      break;
    }
  }
  usedPoint[randomDot] = true;
  XDot(randomDot, 
    imgFace[randomDot*3+0], 
    imgFace[randomDot*3+1], 
    imgFace[randomDot*3+2]
   );
  FastLED.show();
}

void XDot(int x, unsigned int r, unsigned int g, unsigned int b) {
  dot = FacePixelMap[x];
  leds[dot].r = r<0?0:(r>255?255:r);
  leds[dot].g = g<0?0:(g>255?255:g);
  leds[dot].b = b<0?0:(b>255?255:b);
}
